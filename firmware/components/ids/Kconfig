## firmware/components/ids/Kconfig
```kconfig
menu "MeshSentry IDS"

    config MS_WINDOW_S
        int "Detection window (s)"
        default 10

    config MS_FWD_ALPHA_PPM
        int "Selective-forwarding test significance (ppm)"
        default 1000
        help
            One-sided binomial test: alert when P[X <= overheard] under an
            honest forwarder is below alpha. 1000 ppm = 0.001.

    config MS_FWD_Q_PCT
        int "Assumed upstream delivery probability (%)"
        default 90

    config MS_MIN_HANDED
        int "Minimum expected forwards before judging"
        default 6

    config MS_RATE_K_X10
        int "Flooding: deviations above baseline (x10)"
        default 40

    config MS_RATE_MIN_FPS
        int "Flooding: absolute rate floor (frames/s)"
        default 5

    config MS_RATE_WARM
        int "Flooding: windows before the baseline is trusted"
        default 3

    config MS_ROUTE_MIN_CLAIMS
        int "Route: forged hop-1 claims per window"
        default 2

    config MS_REPLAY_MIN
        int "Replay: stale frames per window"
        default 2

    config MS_VOTE_TAU_PCT
        int "Fusion: trust-weighted alert fraction (%)"
        default 50

    config MS_MASS_MIN_X10
        int "Fusion: minimum accusing trust mass (x10)"
        default 9

    config MS_MIN_ACCUSERS
        int "Fusion: minimum distinct accusing monitors"
        default 3

    config MS_SYBIL_DELTA_X10
        int "Sybil: RSSI-signature distance threshold (dB x10)"
        default 15

    config MS_SYBIL_MIN_MONITORS
        int "Sybil: minimum common monitors"
        default 6

endmenu
```

## firmware/components/mesh/Kconfig
```kconfig
menu "MeshSentry mesh"

    config MS_CHANNEL
        int "Wi-Fi channel"
        range 1 13
        default 6

    config MS_TX_POWER_DBM
        int "TX power (dBm)"
        range 2 20
        default 2
        help
            Low TX power shrinks the radio range so that a desk- or
            room-scale testbed forms a multi-hop topology.

    config MS_BEACON_MS
        int "Beacon period (ms)"
        default 2000

    config MS_DATA_MS
        int "Sensor data period (ms)"
        default 5000

    config MS_CTL_OFFSET_MS
        int "Sink control flood offset within a window (ms)"
        default 8000

    config MS_DECIDE_DELAY_MS
        int "Sink fusion delay after window end (ms)"
        default 6000

    config MS_MITIGATION
        bool "Enforce blacklist and local reaction in routing"
        default y

endmenu
```

## firmware/main/Kconfig.projbuild
```kconfig
menu "MeshSentry node"

    choice MS_ROLE
        prompt "Node role"
        default MS_ROLE_NODE

        config MS_ROLE_SINK
            bool "Sink (gateway, runs fusion)"
        config MS_ROLE_NODE
            bool "Sensor node"
        config MS_ROLE_ATTACKER
            bool "Attacker (testbed emulation only)"
    endchoice

    config MS_NODE_ID
        int "Node ID (0 = derive from MAC)"
        range 0 32767
        default 0
        depends on !MS_ROLE_SINK

    choice MS_ATTACK
        prompt "Attack"
        depends on MS_ROLE_ATTACKER
        default MS_ATTACK_SELFWD

        config MS_ATTACK_SELFWD
            bool "Selective forwarding (grayhole/blackhole)"
        config MS_ATTACK_SINKHOLE
            bool "Sinkhole (forged hop-1 claim + blackhole)"
        config MS_ATTACK_FLOOD
            bool "Flooding (authenticated junk at high rate)"
        config MS_ATTACK_REPLAY
            bool "Replay (outsider, verbatim retransmission)"
        config MS_ATTACK_SYBIL
            bool "Sybil (fabricated identities)"
    endchoice

    config MS_ATTACK_START_S
        int "Attack onset after boot (s)"
        depends on MS_ROLE_ATTACKER
        default 150

    config MS_ATTACK_DROP_PCT
        int "Selective forwarding drop probability (%)"
        depends on MS_ATTACK_SELFWD
        range 1 100
        default 60

    config MS_ATTACK_FLOOD_FPS
        int "Flooding rate (frames/s)"
        depends on MS_ATTACK_FLOOD
        default 300

    config MS_ATTACK_REPLAY_FPS
        int "Replay rate (frames/s)"
        depends on MS_ATTACK_REPLAY
        default 4

    config MS_ATTACK_N_SYBIL
        int "Number of Sybil identities"
        depends on MS_ATTACK_SYBIL
        range 1 8
        default 4

endmenu
```
